## kernel-4.14/drivers/input/touchscreen/k6873v1_64_alpha/Himax/Kconfig
```kconfig
source "drivers/input/touchscreen/k6873v1_64_alpha/Himax/hx83112f_noflash/Kconfig"
```

## kernel-4.14/drivers/input/touchscreen/k6873v1_64_alpha/Himax/hx83112f_noflash/Kconfig
```kconfig
config TOUCHPANEL_HIMAX_HX83112F_NOFLASH
	bool "TP himax hx83112f no-flash IC enable or not for custom_o"
	---help---
	say Y to enable driver for Touchpanel useing himax hx83112f no-flash
```

## kernel-4.14/drivers/input/touchscreen/k6873v1_64_alpha/Kconfig
```kconfig
config TOUCHPANEL_MTK_PLATFORM
	bool "CUSTOM_O platform tp module used"
	help
	  Say Y here
	  if you
	  have
	  mtk-platform.

config TOUCHPANEL_LATE_INIT
	bool "mk6360 pmic init"
	help
	  Say Y here
	  if you
	  have
	  mk6360 pmic.

config TOUCHIRQ_UPDATE_QOS
	bool "CUSTOM_O touchpanel driver update qos"
	help
	  Say Y here
	  if you want to
	  update qos value
	  in irq handler.

config TOUCHPANEL_NEW_SET_IRQ_WAKE
	bool "CUSTOM_O platform tp module used"
	help
	  Say Y here
	  if call enable_irq_wake,
	  can not call
	  disable_irq_nosync

config TOUCHPANEL_CUSTOM_O
	bool "CUSTOM_O tp module"
	help
	  Say Y here
	  if you
	  have
	  touchscreen module.

config CUSTOM_O_TP_APK
	bool "CUSTOM_O apk node create"
	help
	  Say Y here
	  if you
	  use apk
	  for TP.

config TOUCHPANEL_MULTI_NOFLASH
	bool "Multiple noflash TPs using"
	help
	  Say Y here
	  if you have
	  multiple
	  noflash touchscreen.

config TOUCHPANEL_NOVA
	bool "TP Nova_IC enable or not for CUSTOM_O"
	---help---
	say Y to enable
	driver for
	Touchpanel
	using NOVATECK_IC
config TOUCHPANEL_HIMAX
	bool "TP HIMAX_IC enable or not for CUSTOM_O"
	---help---
	say Y to
	enable driver
	for Touchpanel
	using HIMAX_IC

if TOUCHPANEL_NOVA
source "drivers/input/touchscreen/k6873v1_64_alpha/Novatek/Kconfig"
endif

if TOUCHPANEL_HIMAX
source "drivers/input/touchscreen/k6873v1_64_alpha/Himax/Kconfig"
endif
```

## kernel-4.14/drivers/input/touchscreen/k6873v1_64_alpha/Novatek/Kconfig
```kconfig
source "drivers/input/touchscreen/k6873v1_64_alpha/Novatek/NT36672C_noflash/Kconfig"
```

## kernel-4.14/drivers/input/touchscreen/k6873v1_64_alpha/Novatek/NT36672C_noflash/Kconfig
```kconfig
config TOUCHPANEL_NOVA_NT36672C_NOFLASH
	bool "TP nova nt36672C IC enable or not for CUSTOM_O"
	---help---
	say Y to enable driver for Touchpanel useing nova nt36672
```

## kernel-4.14/drivers/misc/mediatek/pmic/pm8008/Kconfig
```kconfig
config PM8008_LDO
	bool "QPNP PM8008 PMIC Regulator Driver"
	default y
	---help---
	  Say Y here to support the PM8008 PMIC chip.
	  This driver controls PM8008 PMIC chip and the voltage
	  regulators found in Qualcomm Technologies Inc. PM8008
	  PMIC.
```

## kernel-4.14/drivers/nfc/common/Kconfig
```kconfig
config NFC_COMMON
	bool "NFC Common Utils"
	default y
	---help---
	  NFC Common Utils
```

## kernel-4.14/drivers/nfc/k6873v1_64_alpha/Kconfig
```kconfig
#
source "drivers/nfc/k6873v1_64_alpha/st21nfc-i2c/Kconfig"
source "drivers/nfc/k6873v1_64_alpha/st54-spi/Kconfig"
```

## kernel-4.14/drivers/power/Kconfig
```kconfig
source "drivers/power/avs/Kconfig"
source "drivers/power/reset/Kconfig"
source "drivers/power/supply/Kconfig"

#ifdef VENDOR_EDIT /* LiYue@BSP.CHG.Basic, 2019/09/13, Add for charging */
source "drivers/power/oppo/Kconfig"

config OPPO_CHARGER
	bool "OPPO_CHARGER"
	default n
	help
	  Set Yes to support OPPO_CHARGER features
	  smart battery.
	  Set No to disable OPPO_CHARGER features
	  smart battery.

config OPPO_CHARGER_MTK
	bool "OPPO charger on MTK"
	default n
	help
	  Say Yes here to declare charging system is on MTK
	  Say No here to declare charging system is not on MTK

config OPPO_CHARGER_MTK_CHGIC
	bool "OPPO_CHARGER_MTK_CHG_IC"
	default n
	help
	  Say Yes to use MTK platform charger ic
	  Say No to use extern charger ic

config OPPO_CHARGER_MTK6885
	bool "OPPO_CHARGER_MTK6885"
	default n
	help
	  Set yes to support OPPO_CHARGER_MTK6885 features
	  smart battery.
	  Set No to disable OPPO_CHARGER_MTK6885 features
	  smart battery.

config OPPO_CHARGER_MTK6873
	bool "OPPO_CHARGER_MTK6873"
	default n
	help
	  Set yes to support OPPO_CHARGER_MTK6873 features
	  smart battery.
	  Set No to disable OPPO_CHARGER_MTK6873 features
	  smart battery.

config OPPO_CHARGER_MTK6853
	bool "OPPO_CHARGER_MTK6853"
	default n
	help
	  Set yes to support OPPO_CHARGER_MTK6853 features
	  smart battery.
	  Set No to disable OPPO_CHARGER_MTK6853 features
	  smart battery.

config OPPO_CHARGER_MATCH_MTKGAUGE
	bool "OPPO_CHARGER_MATCH_MTKGAUGE"
	default n
	help
	  Set yes to support use mtk gauge and not use mtk charger features
	  smart battery.
	  Set No to disable OPPO_CHARGER_MATCH_MTKGAUGE features

config OPPO_CHARGER_MTKAGING
	bool "OPPO_CHARGER_MTKAGING"
	default n
	help
	  Set yes to support amend mtk aging algo features
	  Set No to disable OPPO_CHARGER_MTKAGING features

config OPPO_HVDCP_SUPPORT
        bool "OPPO_HVDCP_SUPPORT"
        default n
        help
          Set yes to support hvdcp.

config OPPO_CHECK_CHARGERID_VOLT
	bool "OPPO_CHECK_CHARGERID_VOLT"
	default n
	help
	  Set yes to support OPPO_CHECK_CHARGERID_VOLT features
	  smart battery.
	  Set No to disable OPPO_CHECK_CHARGERID_VOLT features
	  smart battery.

config OPPO_4400MV_BATTERY_SUPPORT
	bool "OPPO_CHECK_CHARGERID_VOLT"
	default n
	help
	  Set yes to support BATTERYID features
	  smart battery.
	  Set No to disable BATTERYID features
	  smart battery.

config OPPO_CALL_MODE_SUPPORT
	bool "OPPO call mode support"
	default n
	help
	  Say Y to enable support for the oppo call mode.

config OPPO_SHIP_MODE_SUPPORT
	bool "OPPO ship mode support"
	default n
	help
	  Say Y to include support

config OPPO_SHORT_HW_CHECK
	bool "OPPO batt HW SHORT"
	default n
	help
	  Say Y to include support

config OPPO_SMART_CHARGER_SUPPORT
        bool "OPPO Smart Charger support"
        default n
        help
          Say Y to include support

config OPPO_DUAL_CHARGER_SUPPORT
	bool "OPPO Dual Charger support"
	default n
	help
	  Say Y to include support

#endif /* VENDOR_EDIT */
```

## kernel-4.14/drivers/soc/oppo/oppo_iomonitor/Kconfig
```kconfig
#ifdef VENDOR_EDIT
#/* Hank.liu@TECH.PLAT.Storage, 2020-02-18, add oppo iomonitor driver*/
config OPPO_IOMONITOR
bool "config oppo iomonitor"
help
    define this config to init oppo iomonitor.
#endif /* VENDOR_EDIT */
```
