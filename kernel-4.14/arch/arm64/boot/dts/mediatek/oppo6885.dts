/*
 * Mediatek's mt6885 SoC device tree source
 *
 * Copyright (C) 2016 MediaTek Inc.
 *
 * This program is free software; you can redistribute it and/or modify
 * it under the terms of the GNU General Public License version 2 as
 * published by the Free Software Foundation.
 *
 * This program is distributed in the hope that it will be useful,
 * but WITHOUT ANY WARRANTY; without even the implied warranty of
 * MERCHANTABILITY or FITNESS FOR A PARTICULAR PURPOSE.
 * See http://www.gnu.org/licenses/gpl-2.0.html for more details.
 */
/dts-v1/;
/plugin/;
#include <dt-bindings/interrupt-controller/irq.h>
#include <dt-bindings/interrupt-controller/arm-gic.h>
#include <dt-bindings/spmi/spmi.h>
#include <dt-bindings/pinctrl/mt6885-pinfunc.h>

&mmc_fixed_3v3 {
	status = "okay";
	regulator-name = "mmc_power";
	regulator-min-microvolt = <3300000>;
	regulator-max-microvolt = <3300000>;
	enable-active-high;
	regulator-always-on;
};

&mmc_fixed_1v8_io {
	status = "okay";
	regulator-name = "mmc_io";
	regulator-min-microvolt = <1800000>;
	regulator-max-microvolt = <1800000>;
	enable-active-high;
	regulator-always-on;
};

&reserved_memory {
};

/*  chosen */
&chosen {

	atag,videolfb-fb_base_l = <0x7e020000>;
	atag,videolfb-fb_base_h = <0x0>;
	atag,videolfb-islcmfound = <1>;
	atag,videolfb-islcm_inited = <0>;
	atag,videolfb-fps= <6000>;
	atag,videolfb-vramSize= <0x1be0000>;
	atag,videolfb-lcmname=
		"nt35595_fhd_dsi_cmd_truly_nt50358_drv";
};

&mmc0 {
	status = "okay";
	/* pinctrl-names = "default", "state_uhs"; */
	/* pinctrl-0 = <&mmc0_pins_default>; */
	/* pinctrl-1 = <&mmc0_pins_uhs>; */
	bus-width = <8>;
	max-frequency = <5000000>;
	cap-mmc-highspeed;
	no-sdio;
	no-sd;
	vmmc-supply = <&mmc_fixed_3v3>;
	vqmmc-supply = <&mmc_fixed_1v8_io>;
	non-removable;
};

&odm {
	led0:led@0 {
		compatible = "mediatek,red";
		led_mode = <0>;
		data = <1>;
		pwm_config = <0 0 0 0 0>;
	};
	led1:led@1 {
		compatible = "mediatek,green";
		led_mode = <0>;
		data = <1>;
		pwm_config = <0 0 0 0 0>;
	};
	led2:led@2 {
		compatible = "mediatek,blue";
		led_mode = <0>;
		data = <1>;
		pwm_config = <0 0 0 0 0>;
	};
	led3:led@3 {
		compatible = "mediatek,jogball-backlight";
		led_mode = <0>;
		data = <1>;
		pwm_config = <0 0 0 0 0>;
	};
	led4:led@4 {
		compatible = "mediatek,keyboard-backlight";
		led_mode = <0>;
		data = <1>;
		pwm_config = <0 0 0 0 0>;
	};
	led5:led@5 {
		compatible = "mediatek,button-backlight";
		led_mode = <0>;
		data = <1>;
		pwm_config = <0 0 0 0 0>;
	};
	led6:led@6 {
		compatible = "mediatek,lcd-backlight";
		led_mode = <4>;
		data = <1>;
		pwm_config = <0 1 0 0 0>;
	};
	vibrator0:vibrator@0 {
		compatible = "mediatek,vibrator";
		//#ifdef VENDOR_EDIT
		/* Xing.Xiong@EXP.BSP.Kernel.Driver.998782, 2017/05/16, Modify for vibrator time less than 9ms */
		vib_timer = <30>;
		vib_limit = <0>;
		//#else
		//vib_timer = <25>;
		//vib_limit = <9>;
		//#endif /* VENDOR_EDIT */
		vib_vol= <11>;
	};
	usb_c_pinctrl:usb_c_pinctrl {
		compatible = "mediatek,usb_c_pinctrl";
	};

/*VENDOR_EDIT keypad start*/
/*Bin.Li@EXP.BSP.bootloader.bootflow, 2017/05/16, Add volume up and down */
	kpd_volume_up:kpd_volume_up {
		compatible = "mediatek, VOLUME_UP-eint";
		interrupt-parent = <&pio>;
		interrupts = <59 IRQ_TYPE_EDGE_FALLING 59 0>;
		debounce = <32000>;
		status = "okay";
	};

	kpd_volume_down:kpd_volume_down {
		compatible = "mediatek, VOLUME_DOWN-eint";
		interrupt-parent = <&pio>;
		interrupts = <155 IRQ_TYPE_EDGE_FALLING 155 0>;
		debounce = <32000>;
		status = "okay";
	};
/*VENDOR_EDIT keypad end*/

//#ifdef VENDOR_EDIT
/*Bin.Li@EXP.BSP.bootloader.bootflow, 2017/05/15, Add for oppo project */
	oppo_project:oppo_project {
		compatible = "oppo,oppo_project";
	};
	oppo_devinfo:oppo_devinfo {
		compatible = "oppo, device_info";
	};
//#endif /*VENDOR_EDIT*/
};

/*VENDOR_EDIT*/
/*Bin.Li@EXP.BSP.bootloader.bootflow, 2017/05/16, Add volume up and down*/
&keypad {
	keypad,volume-up	= <&pio 20 0x00>;
	keypad,volume-down	= <&pio 155 0x00>;
	pinctrl-names = "volume_up_as_int", "volume_down_as_int";
	pinctrl-0 = <&volume_up_gpio_eint>;
	pinctrl-1 = <&volume_down_gpio_eint>;
	status = "okay";
};

&pio {
	volume_up_gpio_eint:volume_up@0{
		pins_cmd_dat {
			pinmux = <PINMUX_GPIO59__FUNC_GPIO59>;
			slew-rate = <0>;  /*direction 0:in, 1:out*/
			input-enable;
		};
	};

	volume_down_gpio_eint:volume_down@0{
		pins_cmd_dat {
			pinmux = <PINMUX_GPIO155__FUNC_GPIO155>;
			slew-rate = <0>;  /*direction 0:in, 1:out*/
			input-enable;
		};
	};
};
/*VENDOR_EDIT*/

//ifdef VENDOR_EDIT
/* Bin.Li@EXP.BSP.bootloader.bootflow, 2017/07/07, Add device-info */
&oppo_devinfo {
	Hw,sub_hwid_1 = <&pio 134 0x00>;
	Hw,sub_hwid_2 = <&pio 132 0x00>;
	Hw,main_hwid_5 = <&pio 53 0x00>;
	Hw,main_hwid_6 = <&pio 55 0x00>;
	pinctrl-names = "hw_sub_id_sleep", "hw_sub_id_active",
			"hw_main_id5_active", "hw_main_id6_active";
	pinctrl-0 = <&hw_pins_sub_id1_sleep &hw_pins_sub_id2_sleep>;
	pinctrl-1 = <&hw_pins_sub_id1_active &hw_pins_sub_id2_active>;
	pinctrl-2 = <&hw_main_id5_active>;
	pinctrl-3 = <&hw_main_id6_active>;
};

&pio {
	hw_pins_sub_id1_sleep:sleep@id1 {
		pins_cmd_dat {
			pinmux = <PINMUX_GPIO134__FUNC_GPIO134>;
			slew-rate = <0>;
			bias-pull-down;
			input-enable;
			};
	};

	hw_pins_sub_id2_sleep:sleep@id2 {
		pins_cmd_dat {
			pinmux = <PINMUX_GPIO132__FUNC_GPIO132>;
			bias-pull-down;
			input-enable;
			};
	};

	hw_pins_sub_id1_active:active@id1 {
		pins_cmd_dat {
			pinmux = <PINMUX_GPIO134__FUNC_GPIO134>;
			slew-rate = <0>;
			bias-pull-up;
			input-enable;
			};
	};
	hw_pins_sub_id2_active:active@id2 {
		pins_cmd_dat {
			pinmux = <PINMUX_GPIO132__FUNC_GPIO132>;
			slew-rate = <0>;
			bias-pull-up;
			input-enable;
			};
	};

	hw_main_id5_active:active@id5 {
		pins_cmd_dat {
			pinmux = <PINMUX_GPIO53__FUNC_GPIO53>;
			slew-rate = <0>;
			bias-pull-down;
			input-enable;
		};
	};

	hw_main_id6_active:active@id6 {
		pins_cmd_dat {
			pinmux = <PINMUX_GPIO55__FUNC_GPIO55>;
			slew-rate = <0>;
			bias-pull-down;
			input-enable;
		};
	};
};
//endif

&i2c0 {
	clock-frequency = <400000>;
	status = "okay";
        synaptics19165@20 {
        	/* general */
        	compatible = "synaptics-s3706";
        	reg = <0x20>;
        	chip-name = "S3706";
        	status = "ok";

        	/* interrupts */
        	interrupt-parent = <&pio>;
        	interrupts = <1 0x2008>;

        	/* Power Config */
        	vdd_2v8-supply  = <&mt_pmic_vtp_ldo_reg>;

        	/* gpio */
        	irq-gpio = <&pio 21 0x2008>;
        	reset-gpio = <&pio 20 0>;

        	/* pinctrl */
        	pinctrl-names = "pmx_ts_active", "pmx_ts_suspend";
        	pinctrl-0 = <&ts_active>;
        	pinctrl-1 = <&ts_suspend>;

        	/* tp physical feature */
        	touchpanel,max-num-support = <10>;
        	touchpanel,tx-rx-num = <16 34>;
        	touchpanel,panel-coords = <1080 2340>;
        	touchpanel,display-coords = <1080 2340>;
        	touchpanel,touchmajor-limit = <0 54>;

//        	/* SW Support Feature Control */
//        	black_gesture_support;
//        	fw_edge_limit_support;
//        	fw_corner_limit_support;
//        	pressure_report_support;
//        	spurious_fingerprint_support;
//        	charger_pump_support;
//        	game_switch_support;
//        	face_detect_support;
//        	smart_gesture_support;
//        	fw_update_app_support;
//        	fingerprint_underscreen_support;
//        	report_120hz_support;
//        	report_point_first_support;
		/*
		*Virtual Key Config:
		*1:touchpanel,button-type: <virtualkey_type  supportted_button-map>
		*virtualkey_type:
		*Type 1: using board_properties
		*Type 2: using same IC (button zone&& touch zone are seprate)
		*Type 3: using diffrent IC (button zone&& touch zone are seprate)
		*Type 4: No need of virtual key process
		*supportted_button-map:select|menu|home|back
		*
		*2:touchpanel,button-map
		*type (X1,Y1)(X2,Y2)(X3,Y3)(Width_X,Hight_Y)--Only when button-type is 0
		*/
		touchpanel,button-type = <4>;
		touchpanel.button-TRx = <0 0>;
        };
	
	Goodix19165@5d {
		compatible = "Goodix-gt9886";
		reg = <0x5d>;
		chip-name = "GT9886";

		/* Interrupt && Irq-gpio */
		interrupt-parent = <&pio>;
		interrupts = <21 IRQ_TYPE_EDGE_FALLING 21 0>;

		/* Power Config */
		vdd_2v8-supply = <&mt_pmic_vtp_ldo_reg>;
        	vdd_2v8_volt = <2950000>;

		/* Other HW Resource */
		irq-gpio = <&pio 21 0x2002>;
		reset-gpio = <&pio 20 0>;
		pinctrl-names = "default";


		touchpanel,max-num-support = <10>;
		touchpanel,tx-rx-num = <15 34>;
		touchpanel,panel-coords = <1080 2400>;
		touchpanel,display-coords = <1080 2400>;
		touchpanel,touchmajor-limit = <0 54>;

		/* SW Support Feature Control */
		register-is-16bit;
		black_gesture_support;
		fw_edge_limit_support;
		pressure_report_support;
		//spurious_fingerprint_support;
		charger_pump_support;
		game_switch_support;
		//face_detect_support;
		smart_gesture_support;
		fw_update_app_support;
		fingerprint_underscreen_support;
		esd_handle_support;
		/*
		 *Virtual Key Config:
		 *1:touchpanel,button-type: <virtualkey_type  supportted_button-map>
		 *virtualkey_type:
		 *Type 1: using board_properties
		 *Type 2: using same IC (button zone&& touch zone are seprate)
		 *Type 3: using diffrent IC (button zone&& touch zone are seprate)
		 *Type 4: No need of virtual key process
		 *supportted_button-map:select|menu|home|back
		 *
		 *2:touchpanel,button-map
		 *type (X1,Y1)(X2,Y2)(X3,Y3)(Width_X,Hight_Y)--Only when button-type is 0
		 */
		touchpanel,button-type = <4>;
		touchpanel.button-TRx = <0 0>;
	};

};

&i2c2 {
	mtk_camera_eeprom0:camera_eeprom0@59 {
		compatible = "mediatek,camera_eeprom";
		reg = <0x59>;
		status = "okay";
	};
};

&i2c8 {
	mtk_camera_eeprom2:camera_eeprom2@51 {
		compatible = "mediatek,camera_eeprom";
		reg = <0x51>;
		status = "okay";
	};
};

&i2c4 {
	mtk_camera_eeprom1:camera_eeprom1@54 {
		compatible = "mediatek,camera_eeprom";
		reg = <0x54>;
		status = "okay";
	};
};

&i2c6 {
	ext_buck_vufs12_mtk:ext_buck_vufs12@56 {
		compatible = "mediatek,ext_buck_vufs12";
		reg = <0x56>;
		regulator-name = "ext_buck_vufs12";
		regulator-min-microvolt = <300000>;
		regulator-max-microvolt = <1300000>;
		status = "okay";
	};
};

&pio {
	ctp_pins_default: eintdefault {
	};
	ctp_ts_int_active: int_active {
		pins_cmd_dat {
			pinmux = <PINMUX_GPIO21__FUNC_GPIO21>;
			slew-rate = <0>;
			bias-pull-up = <11>;
		};
	};
	ctp_ts_reset_active: reset_active {
		pins_cmd_dat {
			pinmux = <PINMUX_GPIO20__FUNC_GPIO20>;
			slew-rate = <1>;
			output-high;
		};
	};
	ctp_ts_int_suspend: int_suspend {
		pins_cmd_dat {
			pinmux = <PINMUX_GPIO21__FUNC_GPIO21>;
			slew-rate = <1>;
			output-low;
		};
	};
	ctp_ts_reset_suspend: reset_suspend {
		pins_cmd_dat {
			pinmux = <PINMUX_GPIO20__FUNC_GPIO20>;
			slew-rate = <1>;
			output-low;
		};
	};
};
/* TOUCH end */

/* DISPSYS GPIO standardization */
&pio {
	mtkfb_pins_lcd_bias_enp1: lcd_bias_enp1_gpio {
		pins_cmd_dat {
			pinmux = <PINMUX_GPIO28__FUNC_GPIO28>;
			slew-rate = <1>;
			output-high;
		};
	};

	mtkfb_pins_lcd_bias_enp0: lcd_bias_enp0_gpio {
		pins_cmd_dat {
			pinmux = <PINMUX_GPIO28__FUNC_GPIO28>;
			slew-rate = <1>;
			output-low;
		};
	};

	mtkfb_pins_lcd_bias_enn1: lcd_bias_enn1_gpio {
		pins_cmd_dat {
			pinmux = <PINMUX_GPIO29__FUNC_GPIO29>;
			slew-rate = <1>;
			output-high;
		};
	};

	mtkfb_pins_lcd_bias_enn0: lcd_bias_enn0_gpio {
		pins_cmd_dat {
			pinmux = <PINMUX_GPIO29__FUNC_GPIO29>;
			slew-rate = <1>;
			output-low;
		};
	};

	mtkfb_pins_lcm_rst_out1_gpio: lcm_rst_out1_gpio {
		pins_cmd_dat {
			pinmux = <PINMUX_GPIO42__FUNC_GPIO42>;
			slew-rate = <1>;
			output-high;
		};
	};

	mtkfb_pins_lcm_rst_out0_gpio: lcm_rst_out0_gpio {
		pins_cmd_dat {
			pinmux = <PINMUX_GPIO42__FUNC_GPIO42>;
			slew-rate = <1>;
			output-low;
		};
	};

	mtkfb_pins_lcm_dsi_te: lcm_dsi_te {
		pins_cmd_dat {
			pinmux = <PINMUX_GPIO41__FUNC_DSI_TE>;
		};
	};
};

&mtkfb {
	pinctrl-names = "lcd_bias_enp1_gpio", "lcd_bias_enp0_gpio",
		"lcd_bias_enn1_gpio", "lcd_bias_enn0_gpio",
		"lcm_rst_out1_gpio", "lcm_rst_out0_gpio",
		"mode_te_te";
	pinctrl-0 = <&mtkfb_pins_lcd_bias_enp1>;
	pinctrl-1 = <&mtkfb_pins_lcd_bias_enp0>;
	pinctrl-2 = <&mtkfb_pins_lcd_bias_enn1>;
	pinctrl-3 = <&mtkfb_pins_lcd_bias_enn0>;
	pinctrl-4 = <&mtkfb_pins_lcm_rst_out1_gpio>;
	pinctrl-5 = <&mtkfb_pins_lcm_rst_out0_gpio>;
	pinctrl-6 = <&mtkfb_pins_lcm_dsi_te>;
	status = "okay";
};

&dispsys_config {
	pinctrl-names =
		"lcm_rst_out1_gpio", "lcm_rst_out0_gpio",
		"mode_te_te";
	pinctrl-0 = <&mtkfb_pins_lcm_rst_out1_gpio>;
	pinctrl-1 = <&mtkfb_pins_lcm_rst_out0_gpio>;
	pinctrl-2 = <&mtkfb_pins_lcm_dsi_te>;
	status = "okay";
};

&bat_gm30 {
	DISABLE_MTKBATTERY = <(1)>;
};

/* DISPSYS GPIO standardization end */

/* accdet start */
&accdet {
	/* accdet micbias voltage: 0x09:2.85v 0x08:2.8v 0x07,
	 * 2.7v;0x05,2.5v;0x02,1.9v
	 */
	accdet-mic-vol = <8>;
	/* accdet pwm_width, pwm_thresh, fall_delay, rise_delay
	 * debounce0, debounce1, debounce3, debounce4
	 * eint pwm_width, eint pwm_thresh
	 * eint deb(debounce0, debounce1, debounce2, debounce3), inv_debounce
	 */
	headset-mode-setting = <0x500 0x500 1 0x1f0
				0x2000 0x800 0x2000 0x44
				0x0 0x7
				0x5 0x9 0x9 0xd 0xe>;
	accdet-plugout-debounce = <1>;
	/*1:ACC mode, 2:low cost without in bias, 6:low cost with in bias*/
	accdet-mic-mode = <2>;
	/*0--MD_MAX--UP_MAX--DW_MAX*/
	//#ifdef VENDOR_EDIT
	//Yongzhi.Zhang@PSW.MM.AudioDriver.HeadsetDet, 2017/14/14, Modify for support headset key
	headset-three-key-threshold = <0 82 170 306>;
	//#else /* VENDOR_EDIT */
	//headset-three-key-threshold = <0 80 220 400>;
	//#endif /* VENDOR_EDIT */
	headset-three-key-threshold-CDD = <0 121 192 600>;
	/*0--MD_MAX--VOICE_MAX--UP_MAX--DW_MAX*/
	headset-four-key-threshold = <0 58 121 192 400>;

	/* moisture HW mode config start. Enable moisture detection or not
	 * default use HW mode for moisture detection
	 */
	moisture_detect_enable = <1>;
	/* select VTH to 2v and 500k, use internal resitance */
	eint_use_ext_res = <0>;
	/* enable eint detection mode, if moisture detection enable
	 * eint_detect_mode = moisture_detect_mode;otherwise, select
	 * eint_detect_mode = 4 as DEFAULT
	 */
	eint_detect_mode = <5>;
	/* enable moisture detection mode, if moisture detection enable
	 * eint_detect_mode = moisture_detect_mode
	 */
	moisture_detect_mode = <5>;
	/* select 0: 2.8V; 1: 2.4V; 2: 2V; 3: VTH=MVTH(VTH2) */
	moisture_comp_vth = <2>;
	/* vref2 voltage for different water impedance */
	//#ifdef VENDOR_EDIT
        //Fanwen.Yang@PSW.MM.AudioDriver.HeadsetDet,2020/4/21
        moisture_comp_vref2 = <2>;
        //#else /* VENDOR_EDIT */
        //moisture_comp_vref2 = <0>;
        //#endif /* VENDOR_EDIT */
	/* moisture HW mode config end */

	/* moisture SW mode config start, use external resister or not.
	 * DEFAULT NOT NEED
	 */
	moisture_use_ext_res = <0>;
	/* moisture external resister ohm, SW mode by auxadc */
	moisture-external-r = <2000000>;
	/* moisture internal resister ohm, SW mode by auxadc */
	moisture-internal-r = <47000>;
	/* moisture of water resister ohm, SW mode by auxadc*/
	moisture-water-r = <10000>;
	/* moisture SW mode config end */
	status = "okay";
};
/* accdet end */

/* IRTX GPIO Start */
&irtx_pwm {
	pinctrl-names = "irtx_gpio_led_default", "irtx_gpio_led_set";
	pinctrl-0 = <&irtx_gpio_led_default>;
	pinctrl-1 = <&irtx_gpio_led_set>;
	status = "okay";
};
&pio {
	/* IRTX GPIO Settings -Start */
	/* default: GPIO0, output, high */
	irtx_gpio_led_default:irtx_gpio_led_def@gpio127 {
		pins_cmd_dat {
			pinmux = <PINMUX_GPIO127__FUNC_GPIO127>;
			slew-rate = <1>;
			bias-disable;
			output-low;
			input-schmitt-enable = <0>;
		};
	};

	irtx_gpio_led_set:irtx_gpio_led_set@gpio127 {
		pins_cmd_dat {
			pinmux = <PINMUX_GPIO127__FUNC_PWM_3>;
			slew-rate = <1>;
			output-high;
		};
	};
}; /* IRTX GPIO Settings -End */

&mt6360_pmu {
	mt6360,intr_gpio_num = <24>; /* direct defined GPIO num */
	mt6360,intr_gpio = <&pio 24 0x0>;
	disable_lpsd = <1>;
};

&mt6360_pmic {
	pwr_off_seq = [04 00 02 02];
};

&mt6360_typec {
	mt6360pd,intr_gpio_num = <25>; /* direct defined GPIO num */
	mt6360pd,intr_gpio = <&pio 25 0x0>;
};

&mt6360_ldo {
	sdcard_det_en = <0>;
};

/* USB SWITCH GPIO start */
&pio {
	usb_default: usb_default {
	};

	gpio_redriver_c1_init: c1_init {
		pins_cmd_dat {
			pinmux = <PINMUX_GPIO113__FUNC_GPIO113>;
			slew-rate = <1>;
			output-low;
		};
	};

	gpio_redriver_c1_low: c1_low {
		pins_cmd_dat {
			pinmux = <PINMUX_GPIO113__FUNC_GPIO113>;
			slew-rate = <1>;
			output-low;
		};
	};

	gpio_redriver_c1_hiz: c1_highz {
		pins_cmd_dat {
			pinmux = <PINMUX_GPIO113__FUNC_GPIO113>;
			slew-rate= <0>;
			bias-disable;
		};
	};

	gpio_redriver_c1_high: c1_high {
		pins_cmd_dat {
			pinmux = <PINMUX_GPIO113__FUNC_GPIO113>;
			slew-rate = <1>;
			output-high;
		};
	};

	gpio_redriver_c2_init: c2_init {
		pins_cmd_dat {
			pinmux = <PINMUX_GPIO112__FUNC_GPIO112>;
			slew-rate = <1>;
			output-low;
		};
	};

	gpio_redriver_c2_low: c2_low {
		pins_cmd_dat {
			pinmux = <PINMUX_GPIO112__FUNC_GPIO112>;
			slew-rate = <1>;
			output-low;
		};
	};

	gpio_redriver_c2_hiz: c2_highz {
		pins_cmd_dat {
			pinmux = <PINMUX_GPIO112__FUNC_GPIO112>;
			slew-rate= <0>;
			bias-disable;
		};
	};

	gpio_redriver_c2_high: c2_high {
		pins_cmd_dat {
			pinmux = <PINMUX_GPIO112__FUNC_GPIO112>;
			slew-rate = <1>;
			output-high;
		};
	};

	gpio_u3_switch_sel1: u3_sw_sel1 {
		pins_cmd_dat {
			pinmux = <PINMUX_GPIO111__FUNC_GPIO111>;
			slew-rate = <1>;
			output-low;
		};
	};

	gpio_u3_switch_sel2: u3_sw_sel2 {
		pins_cmd_dat {
			pinmux = <PINMUX_GPIO111__FUNC_GPIO111>;
			slew-rate = <1>;
			output-high;
		};
	};

	gpio_u3_switch_enable: u3_sw_en {
	};

	gpio_u3_switch_disable: u3_sw_dis {
	};
};

&usb_c_pinctrl {
	pinctrl-names = "usb_default",
		"redrv_c1_init",
		"redrv_c1_low",
		"redrv_c1_hiz",
		"redrv_c1_high",
		"redrv_c2_init",
		"redrv_c2_low",
		"redrv_c2_hiz",
		"redrv_c2_high",
		"switch_sel1",
		"switch_sel2",
		"switch_enable",
		"switch_disable";

	pinctrl-0 = <&usb_default>;
	pinctrl-1 = <&gpio_redriver_c1_init>;
	pinctrl-2 = <&gpio_redriver_c1_low>;
	pinctrl-3 = <&gpio_redriver_c1_hiz>;
	pinctrl-4 = <&gpio_redriver_c1_high>;
	pinctrl-5 = <&gpio_redriver_c2_init>;
	pinctrl-6 = <&gpio_redriver_c2_low>;
	pinctrl-7 = <&gpio_redriver_c2_hiz>;
	pinctrl-8 = <&gpio_redriver_c2_high>;
	pinctrl-9 = <&gpio_u3_switch_sel1>;
	pinctrl-10 = <&gpio_u3_switch_sel2>;
	pinctrl-11 = <&gpio_u3_switch_enable>;
	pinctrl-12 = <&gpio_u3_switch_disable>;
	status = "okay";

	usb_switch-data {
		en_pin_num = <0>;
		en_pin_val = <0>;
		sel_pin_num = <111>;
		sel_pin_val = <1>;
		c1_pin_num = <113>;
		c1_pin_val = <2>;
		c2_pin_num = <112>;
		c2_pin_val = <1>;
	};
};
/* USB SWITCH GPIO end */

/* GPS GPIO standardization start */
&pio {
	gps_pins_default: gps_default {
	};

	gps_l1_lna_pins_ol: gps_l1_lna@0 {
		pins_cmd_dat {
			pinmux = <PINMUX_GPIO162__FUNC_GPIO162>;
			//#ifndef VENDOR_EDIT
			//Wenjie.Liu@PSW.CN.GPS.Hardware.Power.1202743, 2017/12/29,
			//modify for: [GPS_LNA gpio's output direction is out]
			/*
			slew-rate = <0>;
			*/
			//#else /* VENDOR_EDIT */
			slew-rate = <1>;
			//#endif /* VENDOR_EDIT */
			bias-disable;
			output-low;
		};
	};
	gps_l1_lna_pins_dsp_ctrl: gps_l1_lna@1 {
		pins_cmd_dat {
			pinmux = <PINMUX_GPIO162__FUNC_GPS_L1_ELNA_EN>;
			slew-rate = <1>;
		};
	};
	gps_l1_lna_pins_oh: gps_l1_lna@2 {
		pins_cmd_dat {
			pinmux = <PINMUX_GPIO162__FUNC_GPIO162>;
			slew-rate = <1>;
			output-high;
		};
	};

	gps_l5_lna_pins_ol: gps_l5_lna@0 {
		pins_cmd_dat {
			pinmux = <PINMUX_GPIO163__FUNC_GPIO163>;
			//#ifndef VENDOR_EDIT
			//Wenjie.Liu@PSW.CN.GPS.Hardware.Power.1202743, 2017/12/29,
			//modify for: [GPS_LNA gpio's output direction is out]
			/*
			slew-rate = <0>;
			*/
			//#else /* VENDOR_EDIT */
			slew-rate = <1>;
			//#endif /* VENDOR_EDIT */
			bias-disable;
			output-low;
		};
	};
	gps_l5_lna_pins_dsp_ctrl: gps_l5_lna@1 {
		pins_cmd_dat {
			pinmux = <PINMUX_GPIO163__FUNC_GPS_L5_ELNA_EN>;
			slew-rate = <1>;
		};
	};
	gps_l5_lna_pins_oh: gps_l5_lna@2 {
		pins_cmd_dat {
			pinmux = <PINMUX_GPIO163__FUNC_GPIO163>;
			slew-rate = <1>;
			output-high;
		};
	};
};

&gps {
	pinctrl-names = "default",
		"gps_l1_lna_disable",
		"gps_l1_lna_dsp_ctrl",
		"gps_l1_lna_enable",
		"gps_l5_lna_disable",
		"gps_l5_lna_dsp_ctrl",
		"gps_l5_lna_enable";
	pinctrl-0 = <&gps_pins_default>;
	pinctrl-1 = <&gps_l1_lna_pins_ol>;
	pinctrl-2 = <&gps_l1_lna_pins_dsp_ctrl>;
	pinctrl-3 = <&gps_l1_lna_pins_oh>;
	pinctrl-4 = <&gps_l5_lna_pins_ol>;
	pinctrl-5 = <&gps_l5_lna_pins_dsp_ctrl>;
	pinctrl-6 = <&gps_l5_lna_pins_oh>;
	status = "okay";
};
/* GPS GPIO standardization end */

&pio {
	ts_active: ts_active1 {
		pins_cmd_dat {
			pinmux = <PINMUX_GPIO2__FUNC_GPIO2>;
			slew-rate = <1>;
			output-high;
		};
	};
	ts_suspend: ts_suspend1 {
		pins_cmd_dat {
			pinmux = <PINMUX_GPIO2__FUNC_GPIO2>;
			slew-rate = <1>;
			output-low;
		};
	};
};

/* CAMERA GPIO standardization */
&pio {
	camera0_rst_low: camera0_rst_output_low@gpio144 {
		pins_cmd_dat {
			pinmux = <PINMUX_GPIO144__FUNC_GPIO144>;
			output-low;
		};
	};
	camera0_rst_high: camera0_rst_output_high@gpio144 {
		pins_cmd_dat {
			pinmux = <PINMUX_GPIO144__FUNC_GPIO144>;
			output-high;
		};
	};
	camera0_pdn_low: camera0_pdn_output_low {
		pins_cmd_dat1 {
			pinmux = <PINMUX_GPIO133__FUNC_GPIO133>;
			output-low;
		};
		pins_cmd_dat2 {
			pinmux = <PINMUX_GPIO135__FUNC_GPIO135>;
			output-low;
		};
	};
	camera0_pdn_high: camera0_pdn_output_high {
		pins_cmd_dat1 {
			pinmux = <PINMUX_GPIO133__FUNC_GPIO133>;
			output-high;
		};
		pins_cmd_dat2 {
			pinmux = <PINMUX_GPIO135__FUNC_GPIO135>;
			output-high;
		};
	};
	camera1_rst_low: camera1_rst_output_low@gpio143 {
		pins_cmd_dat {
			pinmux = <PINMUX_GPIO143__FUNC_GPIO143>;
			output-low;
		};
	};
	camera1_rst_high: camera1_rst_output_high@gpio143 {
		pins_cmd_dat {
			pinmux = <PINMUX_GPIO143__FUNC_GPIO143>;
			output-high;
		};
	};
	camera1_pdn_low: camera1_pdn_output_low@gpio122 {
		pins_cmd_dat {
			pinmux = <PINMUX_GPIO122__FUNC_GPIO122>;
			output-low;
		};
	};
	camera1_pdn_high: camera1_pdn_output_high@gpio122 {
		pins_cmd_dat {
			pinmux = <PINMUX_GPIO122__FUNC_GPIO122>;
			output-high;
		};
	};
	camera2_rst_low: camera2_rst_output_low@gpio145 {
		pins_cmd_dat {
			pinmux = <PINMUX_GPIO145__FUNC_GPIO145>;
			output-low;
		};
	};
	camera2_rst_high: camera2_rst_output_high@gpio145 {
		pins_cmd_dat {
			pinmux = <PINMUX_GPIO145__FUNC_GPIO145>;
			output-high;
		};
	};
	camera2_pdn_low: camera2_pdn_output_low@gpio146 {
		pins_cmd_dat {
			pinmux = <PINMUX_GPIO146__FUNC_GPIO146>;
			output-low;
		};
	};
	camera2_pdn_high: camera2_pdn_output_high@gpio146 {
		pins_cmd_dat {
			pinmux = <PINMUX_GPIO146__FUNC_GPIO146>;
			output-high;
		};
	};
	camera3_rst_low: camera3_rst_output_low@gpio130 {
		pins_cmd_dat {
			pinmux = <PINMUX_GPIO130__FUNC_GPIO130>;
			output-low;
		};
	};
	camera3_rst_high: camera3_rst_output_high@gpio130 {
		pins_cmd_dat {
			pinmux = <PINMUX_GPIO130__FUNC_GPIO130>;
			output-high;
		};
	};
	camera3_pdn_low: camera3_pdn_output_low@gpio122 {
		pins_cmd_dat {
			pinmux = <PINMUX_GPIO122__FUNC_GPIO122>;
			output-low;
		};
	};
	camera3_pdn_high: camera3_pdn_output_high@gpio122 {
		pins_cmd_dat {
			pinmux = <PINMUX_GPIO122__FUNC_GPIO122>;
			output-high;
		};
	};
	camera4_rst_low: camera4_rst_output_low@gpio131 {
		pins_cmd_dat {
			pinmux = <PINMUX_GPIO131__FUNC_GPIO131>;
			output-low;
		};
	};
	camera4_rst_high: camera4_rst_output_high@gpio131 {
		pins_cmd_dat {
			pinmux = <PINMUX_GPIO131__FUNC_GPIO131>;
			output-high;
		};
	};
	camera4_pdn_low: camera4_pdn_output_low@gpio148 {
		pins_cmd_dat {
			pinmux = <PINMUX_GPIO148__FUNC_GPIO148>;
			output-low;
		};
	};
	camera4_pdn_high: camera4_pdn_output_high@gpio148 {
		pins_cmd_dat {
			pinmux = <PINMUX_GPIO148__FUNC_GPIO148>;
			output-high;
		};
	};
	camera0_vcama_off: camera0_vcama_off {
		pins_cmd_dat {
			pinmux = <PINMUX_GPIO133__FUNC_GPIO133>;
			output-low;
		};
	};
	camera0_vcama_on: camera0_vcama_on {
		pins_cmd_dat {
			pinmux = <PINMUX_GPIO133__FUNC_GPIO133>;
			output-high;
		};
	};
	camera0_vcama1_off: camera0_vcama1_off {
		pins_cmd_dat {
			pinmux = <PINMUX_GPIO135__FUNC_GPIO135>;
			output-low;
		};
	};
	camera0_vcama1_on: camera0_vcama1_on {
		pins_cmd_dat {
			pinmux = <PINMUX_GPIO135__FUNC_GPIO135>;
			output-high;
		};
	};
	camera0_vcamd_off: camera0_vcamd_output_low@gpio147 {
		pins_cmd_dat {
			pinmux = <PINMUX_GPIO147__FUNC_GPIO147>;
			slew-rate = <1>;
			output-low;
		};
	};
	camera0_vcamd_on: camera0_vcamd_output_high@gpio147 {
		pins_cmd_dat {
			pinmux = <PINMUX_GPIO147__FUNC_GPIO147>;
			output-high;
		};
	};
	camera1_vcama_off: camera1_vcama_output_low@gpio8 {
		pins_cmd_dat {
			pinmux = <PINMUX_GPIO8__FUNC_GPIO8>;
			output-low;
		};
	};
	camera1_vcama_on: camera1_vcama_output_high@gpio8 {
		pins_cmd_dat {
			pinmux = <PINMUX_GPIO8__FUNC_GPIO8>;
			output-high;
		};
	};
	camera1_vcamd_off: camera1_vcamd_output_low@gpio147 {
		pins_cmd_dat {
			pinmux = <PINMUX_GPIO147__FUNC_GPIO147>;
			slew-rate = <1>;
			output-low;
		};
	};
	camera1_vcamd_on: camera1_vcamd_output_high@gpio147 {
		pins_cmd_dat {
			pinmux = <PINMUX_GPIO147__FUNC_GPIO147>;
			output-high;
		};
	};
	camera2_vcama_off: camera2_vcama_output_low@gpio148 {
		pins_cmd_dat {
			pinmux = <PINMUX_GPIO148__FUNC_GPIO148>;
			output-low;
		};
	};
	camera2_vcama_on: camera2_vcama_output_high@gpio148 {
		pins_cmd_dat {
			pinmux = <PINMUX_GPIO148__FUNC_GPIO148>;
			output-high;
		};
	};
	camera2_vcamd_off: camera2_vcamd_output_low@gpio146 {
		pins_cmd_dat {
			pinmux = <PINMUX_GPIO146__FUNC_GPIO146>;
			output-low;
		};
	};
	camera2_vcamd_on: camera2_vcamd_output_high@gpio146 {
		pins_cmd_dat {
			pinmux = <PINMUX_GPIO146__FUNC_GPIO146>;
			output-high;
		};
	};
	camera3_vcama_off: camera3_vcama_output_low@gpio148 {
		pins_cmd_dat {
			pinmux = <PINMUX_GPIO148__FUNC_GPIO148>;
			output-low;
		};
	};
	camera3_vcama_on: camera3_vcama_output_high@gpio148 {
		pins_cmd_dat {
			pinmux = <PINMUX_GPIO148__FUNC_GPIO148>;
			output-high;
		};
	};
	camera3_vcamd_off: camera3_vcamd_output_low@gpio146 {
		pins_cmd_dat {
			pinmux = <PINMUX_GPIO146__FUNC_GPIO146>;
			slew-rate = <1>;
			output-low;
		};
	};
	camera3_vcamd_on: camera3_vcamd_output_high@gpio146 {
		pins_cmd_dat {
			pinmux = <PINMUX_GPIO146__FUNC_GPIO146>;
			output-high;
		};
	};
	camera4_vcama_off: camera4_vcama_output_low@gpio148 {
		pins_cmd_dat {
			pinmux = <PINMUX_GPIO148__FUNC_GPIO148>;
			output-low;
		};
	};
	camera4_vcama_on: camera4_vcama_output_high@gpio148 {
		pins_cmd_dat {
			pinmux = <PINMUX_GPIO148__FUNC_GPIO148>;
			output-high;
		};
	};
	camera4_vcamd_off: camera4_vcamd_output_low@gpio146 {
		pins_cmd_dat {
			pinmux = <PINMUX_GPIO146__FUNC_GPIO146>;
			output-low;
		};
	};
	camera4_vcamd_on: camera4_vcamd_output_high@gpio146 {
		pins_cmd_dat {
			pinmux = <PINMUX_GPIO146__FUNC_GPIO146>;
			output-high;
		};
	};

	camera0_mclk_2ma: camera0_mclk_2ma@gpio150 {
		pins_cmd_dat {
			pinmux = <PINMUX_GPIO150__FUNC_CMMCLK1>;
			drive-strength = <0>;
		};
	};
	camera0_mclk_4ma: camera0_mclk_4ma@gpio150 {
		pins_cmd_dat {
			pinmux = <PINMUX_GPIO150__FUNC_CMMCLK1>;
			drive-strength = <1>;
		};
	};
	camera0_mclk_6ma: camera0_mclk_6ma@gpio150 {
		pins_cmd_dat {
			pinmux = <PINMUX_GPIO150__FUNC_CMMCLK1>;
			drive-strength = <2>;
		};
	};
	camera0_mclk_8ma: camera0_mclk_8ma@gpio150 {
		pins_cmd_dat {
			pinmux = <PINMUX_GPIO150__FUNC_CMMCLK1>;
			drive-strength = <3>;
		};
	};
	camera0_mclk_off: camera0_mclk_gpio_mode@gpio150 {
		pins_cmd_dat {
			pinmux = <PINMUX_GPIO150__FUNC_GPIO150>;
			drive-strength = <1>;
		};
	};
	camera1_mclk_2ma: camera1_mclk_2ma@gpio149 {
		pins_cmd_dat {
			pinmux = <PINMUX_GPIO149__FUNC_CMMCLK0>;
			drive-strength = <0>;
		};
	};
	camera1_mclk_4ma: camera1_mclk_4ma@gpio149 {
		pins_cmd_dat {
			pinmux = <PINMUX_GPIO149__FUNC_CMMCLK0>;
			drive-strength = <1>;
		};
	};
	camera1_mclk_6ma: camera1_mclk_6ma@gpio149 {
		pins_cmd_dat {
			pinmux = <PINMUX_GPIO149__FUNC_CMMCLK0>;
			drive-strength = <2>;
		};
	};
	camera1_mclk_8ma: camera1_mclk_8ma@gpio149 {
		pins_cmd_dat {
			pinmux = <PINMUX_GPIO149__FUNC_CMMCLK0>;
			drive-strength = <3>;
		};
	};
	camera1_mclk_off: camera1_mclk_gpio_mode@gpio149 {
		pins_cmd_dat {
			pinmux = <PINMUX_GPIO149__FUNC_GPIO149>;
			drive-strength = <1>;
		};
	};
	camera2_mclk_2ma: camera2_mclk_2ma@gpio151 {
		pins_cmd_dat {
			pinmux = <PINMUX_GPIO151__FUNC_CMMCLK2>;
			drive-strength = <0>;
		};
	};
	camera2_mclk_4ma: camera2_mclk_4ma@gpio151 {
		pins_cmd_dat {
			pinmux = <PINMUX_GPIO151__FUNC_CMMCLK2>;
			drive-strength = <1>;
		};
	};
	camera2_mclk_6ma: camera2_mclk_6ma@gpio151 {
		pins_cmd_dat {
			pinmux = <PINMUX_GPIO151__FUNC_CMMCLK2>;
			drive-strength = <2>;
		};
	};
	camera2_mclk_8ma: camera2_mclk_8ma@gpio151 {
		pins_cmd_dat {
			pinmux = <PINMUX_GPIO151__FUNC_CMMCLK2>;
			drive-strength = <3>;
		};
	};
	camera2_mclk_off: camera2_mclk_gpio_mode@gpio151 {
		pins_cmd_dat {
			pinmux = <PINMUX_GPIO151__FUNC_GPIO151>;
			drive-strength = <1>;
		};
	};
	camera3_mclk_2ma: camera3_mclk_2ma@gpio136 {
		pins_cmd_dat {
			pinmux = <PINMUX_GPIO136__FUNC_CMMCLK3>;
			drive-strength = <0>;
		};
	};
	camera3_mclk_4ma: camera3_mclk_4ma@gpio136 {
		pins_cmd_dat {
			pinmux = <PINMUX_GPIO136__FUNC_CMMCLK3>;
			drive-strength = <1>;
		};
	};
	camera3_mclk_6ma: camera3_mclk_6ma@gpio136 {
		pins_cmd_dat {
			pinmux = <PINMUX_GPIO136__FUNC_CMMCLK3>;
			drive-strength = <2>;
		};
	};
	camera3_mclk_8ma: camera3_mclk_8ma@gpio136 {
		pins_cmd_dat {
			pinmux = <PINMUX_GPIO136__FUNC_CMMCLK3>;
			drive-strength = <3>;
		};
	};
	camera3_mclk_off: camera3_mclk_gpio_mode@gpio136 {
		pins_cmd_dat {
			pinmux = <PINMUX_GPIO136__FUNC_GPIO136>;
			drive-strength = <1>;
		};
	};
	camera4_mclk_2ma: camera4_mclk_2ma@gpio137 {
		pins_cmd_dat {
			pinmux = <PINMUX_GPIO137__FUNC_CMMCLK4>;
			drive-strength = <0>;
		};
	};
	camera4_mclk_4ma: camera4_mclk_4ma@gpio137 {
		pins_cmd_dat {
			pinmux = <PINMUX_GPIO137__FUNC_CMMCLK4>;
			drive-strength = <1>;
		};
	};
	camera4_mclk_6ma: camera4_mclk_6ma@gpio137 {
		pins_cmd_dat {
			pinmux = <PINMUX_GPIO137__FUNC_CMMCLK4>;
			drive-strength = <2>;
		};
	};
	camera4_mclk_8ma: camera4_mclk_8ma@gpio137 {
		pins_cmd_dat {
			pinmux = <PINMUX_GPIO137__FUNC_CMMCLK4>;
			drive-strength = <3>;
		};
	};
	camera4_mclk_off: camera4_mclk_gpio_mode@gpio137 {
		pins_cmd_dat {
			pinmux = <PINMUX_GPIO137__FUNC_GPIO137>;
			drive-strength = <1>;
		};
	};
	camera_pins_default: camdefault {
	};
};
&kd_camera_hw1 {
	pinctrl-names = "default",
			"cam0_rst0", "cam0_rst1",
			"cam0_pnd0", "cam0_pnd1",
			"cam1_rst0", "cam1_rst1",
			"cam1_pnd0", "cam1_pnd1",
			"cam2_rst0", "cam2_rst1",
			"cam2_pnd0", "cam2_pnd1",
			"cam3_rst0", "cam3_rst1",
			"cam3_pnd0", "cam3_pnd1",
			"cam4_rst0", "cam4_rst1",
			"cam4_pnd0", "cam4_pnd1",
			"cam0_ldo_vcama_0", "cam0_ldo_vcama_1",
			"cam0_ldo_vcama1_0", "cam0_ldo_vcama1_1",
			"cam0_ldo_vcamd_0", "cam0_ldo_vcamd_1",
			"cam1_ldo_vcama_0", "cam1_ldo_vcama_1",
			"cam1_ldo_vcamd_0", "cam1_ldo_vcamd_1",
			"cam2_ldo_vcama_0", "cam2_ldo_vcama_1",
			"cam2_ldo_vcamd_0", "cam2_ldo_vcamd_1",
			"cam3_ldo_vcama_0", "cam3_ldo_vcama_1",
			"cam3_ldo_vcamd_0", "cam3_ldo_vcamd_1",
			"cam4_ldo_vcama_0", "cam4_ldo_vcama_1",
			"cam4_ldo_vcamd_0", "cam4_ldo_vcamd_1",
			"cam0_mclk_off",
			"cam0_mclk_2mA", "cam0_mclk_4mA",
			"cam0_mclk_6mA", "cam0_mclk_8mA",
			"cam1_mclk_off",
			"cam1_mclk_2mA", "cam1_mclk_4mA",
			"cam1_mclk_6mA", "cam1_mclk_8mA",
			"cam2_mclk_off",
			"cam2_mclk_2mA", "cam2_mclk_4mA",
			"cam2_mclk_6mA", "cam2_mclk_8mA",
			"cam3_mclk_off",
			"cam3_mclk_2mA", "cam3_mclk_4mA",
			"cam3_mclk_6mA", "cam3_mclk_8mA",
			"cam4_mclk_off",
			"cam4_mclk_2mA", "cam4_mclk_4mA",
			"cam4_mclk_6mA", "cam4_mclk_8mA";
	pinctrl-0 = <&camera_pins_default>;
	pinctrl-1 = <&camera0_rst_low>;
	pinctrl-2 = <&camera0_rst_high>;
	pinctrl-3 = <&camera0_pdn_low>;
	pinctrl-4 = <&camera0_pdn_high>;
	pinctrl-5 = <&camera1_rst_low>;
	pinctrl-6 = <&camera1_rst_high>;
	pinctrl-7 = <&camera1_pdn_low>;
	pinctrl-8 = <&camera1_pdn_high>;
	pinctrl-9 = <&camera2_rst_low>;
	pinctrl-10 = <&camera2_rst_high>;
	pinctrl-11 = <&camera2_pdn_low>;
	pinctrl-12 = <&camera2_pdn_high>;
	pinctrl-13 = <&camera3_rst_low>;
	pinctrl-14 = <&camera3_rst_high>;
	pinctrl-15 = <&camera3_pdn_low>;
	pinctrl-16 = <&camera3_pdn_high>;
	pinctrl-17 = <&camera4_rst_low>;
	pinctrl-18 = <&camera4_rst_high>;
	pinctrl-19 = <&camera4_pdn_low>;
	pinctrl-20 = <&camera4_pdn_high>;
	pinctrl-21 = <&camera0_vcama_off>;
	pinctrl-22 = <&camera0_vcama_on>;
	pinctrl-23 = <&camera0_vcama1_off>;
	pinctrl-24 = <&camera0_vcama1_on>;
	pinctrl-25 = <&camera0_vcamd_off>;
	pinctrl-26 = <&camera0_vcamd_on>;
	pinctrl-27 = <&camera1_vcama_off>;
	pinctrl-28 = <&camera1_vcama_on>;
	pinctrl-29 = <&camera1_vcamd_off>;
	pinctrl-30 = <&camera1_vcamd_on>;
	pinctrl-31 = <&camera2_vcama_off>;
	pinctrl-32 = <&camera2_vcama_on>;
	pinctrl-33 = <&camera2_vcamd_off>;
	pinctrl-34 = <&camera2_vcamd_on>;
	pinctrl-35 = <&camera3_vcama_off>;
	pinctrl-36 = <&camera3_vcama_on>;
	pinctrl-37 = <&camera3_vcamd_off>;
	pinctrl-38 = <&camera3_vcamd_on>;
	pinctrl-39 = <&camera4_vcama_off>;
	pinctrl-40 = <&camera4_vcama_on>;
	pinctrl-41 = <&camera4_vcamd_off>;
	pinctrl-42 = <&camera4_vcamd_on>;
	pinctrl-43 = <&camera0_mclk_off>;
	pinctrl-44 = <&camera0_mclk_2ma>;
	pinctrl-45 = <&camera0_mclk_4ma>;
	pinctrl-46 = <&camera0_mclk_6ma>;
	pinctrl-47 = <&camera0_mclk_8ma>;
	pinctrl-48 = <&camera1_mclk_off>;
	pinctrl-49 = <&camera1_mclk_2ma>;
	pinctrl-50 = <&camera1_mclk_4ma>;
	pinctrl-51 = <&camera1_mclk_6ma>;
	pinctrl-52 = <&camera1_mclk_8ma>;
	pinctrl-53 = <&camera2_mclk_off>;
	pinctrl-54 = <&camera2_mclk_2ma>;
	pinctrl-55 = <&camera2_mclk_4ma>;
	pinctrl-56 = <&camera2_mclk_6ma>;
	pinctrl-57 = <&camera2_mclk_8ma>;
	pinctrl-58 = <&camera3_mclk_off>;
	pinctrl-59 = <&camera3_mclk_2ma>;
	pinctrl-60 = <&camera3_mclk_4ma>;
	pinctrl-61 = <&camera3_mclk_6ma>;
	pinctrl-62 = <&camera3_mclk_8ma>;
	pinctrl-63 = <&camera4_mclk_off>;
	pinctrl-64 = <&camera4_mclk_2ma>;
	pinctrl-65 = <&camera4_mclk_4ma>;
	pinctrl-66 = <&camera4_mclk_6ma>;
	pinctrl-67 = <&camera4_mclk_8ma>;

	cam0_vcamio-supply = <&mt_pmic_vcamio_ldo_reg>;
	cam1_vcamio-supply = <&mt_pmic_vcamio_ldo_reg>;
	cam2_vcamio-supply = <&mt_pmic_vcamio_ldo_reg>;
	cam3_vcamio-supply = <&mt_pmic_vcamio_ldo_reg>;
	cam4_vcamio-supply = <&mt_pmic_vcamio_ldo_reg>;

	vcamaf-supply = <&mt_pmic_vmc_ldo_reg>;

	cam0_enable_sensor = "imx686_mipi_raw";
	cam1_enable_sensor = "s5kgd1sp_mipi_raw";
	cam2_enable_sensor = "hi846_mipi_raw";
	cam3_enable_sensor = "gc02m0b_mipi_mono";
	cam4_enable_sensor = "gc02m0b_mipi_mono1";

	status = "okay";
};

&dsi0 {
	status = "okay";
	#address-cells = <1>;
	#size-cells = <0>;
	panel1@0 {
		compatible = "s68fc01,lcm";
		reg = <0>;
		pm-enable-gpios = <&pio 41 0>;
		reset-gpios = <&pio 42 0>;
		bias-gpio = <&pio 29 0>;
		pinctrl-names = "default";
		port {
			panel_in: endpoint {
				remote-endpoint = <&dsi_out>;
			};
		};
	};
	ports {
		port {
			dsi_out: endpoint {
				remote-endpoint = <&panel_in>;
			};
		};
	};
};

//ifdef VENDOR_EDIT
//Hongdao.yu@BSP.Fingerprint.Basic, 2018/09/10, add for fingerprint
&oppo_fp_common {
    oppo,fp_gpio = <190>;
    pinctrl-names = "default";
    pinctrl-0 = <&gpio_id0_default>;
    goodix_optical {
        oppo,fp-id = <0>; /* fp id mapping table */
        vendor-chip = <11>; /* please refer to the struct fp_vendor_t in oppo_fp_commmon.n */
        eng-menu = "-1,-1"; /* represents SNR, inclination test item in engineer menu, and 0/1 means off/on */
        chip-name = "G_OPTICAL_G3";  /* /proc/fp_id, will be displayed in engineer menu  */
	};
};

&pio{
	gpio_id0_default: gpio_id0_default {
		pins_cmd_dat {
			pinmux = <PINMUX_GPIO190__FUNC_GPIO190>;
			slew-rate = <0>;
			bias-pull-up = <00>;
			input-enable;
		};
	};
};

&goodix_fp {
    goodix,gpio_irq = <&pio 15 0x00>;
    goodix,gpio_reset = <&pio 14 0x00>;
    goodix,gpio_cs = <&pio 157 0x00>;
    pinctrl-names = "default", "gf_spi_drive_6mA", "gf_cs_func";
    pinctrl-0 = <&gpio_goodix_irq_default>, <&gpio_goodix_reset_default>;
    pinctrl-1 = <&gpio_goodix_clk_6mA>, <&gpio_goodix_mosi_6mA>, <&gpio_goodix_miso_6mA>, <&gpio_goodix_cs_6mA>;
    pinctrl-2 = <&gpio_goodix_cs_func>;
    status = "okay";
};

&spi1 {
	#address-cells = <1>;
	#size-cells = <0>;
	status = "okay";
	oppo_fp: fingerprint@0 {
		compatible = "oppo,oppo_fp";
		reg = <0>;
		spi-max-frequency = <8000000>;
		spi-id = <1>;
		spi-irq = <39>;
		spi-reg = <11010000>;
		avdd-supply = <&mt_pmic_vmch_ldo_reg>;
		avdd-config = <3300000 3300000 150000>;
		dvdd-supply = <&mt_pmic_vfp_ldo_reg>;
		dvdd-config = <1800000 1800000 150000>;
		power-num = <2>;
		status = "okay";
		power_source_1 {
			power-mode = <1>;
			power-name = "avdd";
			power-config = "avdd-config";
			delay-time = <0>;
		};
		power_source_2 {
			power-mode = <1>;
			power-name = "dvdd";
			power-config = "dvdd-config";
			delay-time = <0>;
		};
	};
};
/* 1 = ldo power, refer to oppo_fp_common.h*/
&pio{
    gpio_goodix_reset_default: gpio_goodix_reset_default {
        pins_cmd_dat {
            pinmux = <PINMUX_GPIO14__FUNC_GPIO14>;
            slew-rate = <1>;
            output-low;
        };
    };
    gpio_goodix_irq_default: gpio_goodix_irq_default {
        pins_cmd_dat {
            pinmux = <PINMUX_GPIO15__FUNC_GPIO15>;
            slew-rate = <0>;
            bias-pull-down;
        };
    };
    gpio_goodix_clk_6mA: gpio_goodix_clk_6mA {
        pins_cmd_dat {
            pinmux = <PINMUX_GPIO156__FUNC_SPI1_A_CLK>;
            drive-strength = <2>;
        };
    };
    gpio_goodix_mosi_6mA: gpio_goodix_mosi_6mA {
        pins_cmd_dat {
			pinmux = <PINMUX_GPIO159__FUNC_SPI1_A_MO>;
            drive-strength = <2>;
        };
    };
    gpio_goodix_miso_6mA: gpio_goodix_miso_6mA {
        pins_cmd_dat {
			pinmux = <PINMUX_GPIO158__FUNC_SPI1_A_MI>;
            drive-strength = <3>;
        };
    };
    gpio_goodix_cs_6mA: gpio_goodix_cs_6mA {
        pins_cmd_dat {
			pinmux = <PINMUX_GPIO157__FUNC_SPI1_A_CSB>;
            drive-strength = <2>;
        };
    };
    gpio_goodix_cs_func: gpio_goodix_cs_func {
        pins_cmd_dat {
            pinmux = <PINMUX_GPIO157__FUNC_SPI1_A_CSB>;
            drive-strength = <2>;
        };
    };
};
//#endif

//ifdef VENDOR_EDIT
//zhou.Zheng@CN.NFC.Basic.Hardware.2331068, 2019/09/29,
//Add for:NFC NXP device
&i2c3 {
	status = "okay";
	nfc_nxp@28 {
		compatible = "nxp,pn544";
		reg = <0x28>;
		nxp,pn544-irq = <&pio 7 0x0>;
		nxp,pn544-ven = <&pio 16 0x0>;
		nxp,pn544-fw-dwnld = <&pio 6 0x0>;
		nxp,pn544-clkreq = <&pio 17 0x0>;
		interrupt-parent = <&pio>;
	};
};

&spi5 {
	status = "okay";
	#address-cells = <1>;
	#size-cells = <0>;
	spidev5: p61@5 {
	compatible = "nxp,p61";
	reg = <0>;
	spi-max-frequency = <8000000>;
	};
};
//#endif

//#ifdef VENDOR_EDIT /* LiYue@BSP.CHG.Basic, 2019/09/13, Add for charging */
&odm {
	vooc_ap_data:vooc_ap_data {
		compatible = "mediatek, VOOC_AP_DATA-eint";
		interrupts = <9 IRQ_TYPE_EDGE_FALLING 9 0>;
	};
	vooc_ap_data_new_function:vooc_ap_data_new_function {
		compatible = "mediatek, VOOC_EINT_NEW_FUNCTION";
	};
};

&charger {
	io-channels = <&auxadc 3>,
		<&auxadc 4>,
		<&auxadc 5>;
	io-channel-names = "auxadc3-charger_id",
		"auxadc4-usb_temp_v_l",
		"auxadc5-usb_temp_v_r";

	pinctrl-names = "default", "charger_gpio_as_output_low", "charger_gpio_as_output_high", "ship_sleep", "ship_active", "dischg_enable", "dischg_disable";
	pinctrl-0 = <&charger_pins_default>;
	pinctrl-1 = <&charger_pins_eint_output0>;
	pinctrl-2 = <&charger_pins_eint_output1>;
	pinctrl-3 = <&ship_sleep_gpio>;
	pinctrl-4 = <&ship_active_gpio>;
	pinctrl-5 = <&dischg_enable>;
	pinctrl-6 = <&dischg_disable>;
	//pinctrl-5 = <&shortc_active_gpio>;

	//for oppo chg framework:
	qcom,input_current_charger_ma = <2000>;
	qcom,pd_input_current_charger_ma = <3000>;
	qcom,input_current_usb_ma = <500>;

	qcom,input_current_led_ma = <1200>;
	qcom,input_current_led_ma_high = <1200>;
	qcom,input_current_led_ma_warm = <1500>;
	qcom,input_current_led_ma_normal = <2000>;

	qcom,input_current_camera_ma = <1200>;
	qcom,input_current_cdp_ma = <1500>;

	//qcom,input_current_led_ma_overtemp = <900>;
	qcom,overtemp_bat_decidegc = <350>;
	qcom,iterm_disabled = <0>;
	sw_full_count = <25>;
	qcom,iterm_ma = <215>;
	qcom,recharge-mv = <100>;
	qcom,batt_capacity_mah = <3935>;  /*rated capacity*/
	//qcom,batt_capacity_mah = <4025>;  /*typical capacity*/

	qcom,removed_bat_decidegc = <190>;  /*<-19C*/

	qcom,cold_bat_decidegc = <20>;  /*-2C~0C*/
	qcom,temp_cold_vfloat_mv = <3980>;
	qcom,temp_cold_fastchg_current_ma = <330>;    /*300-364mA*/

	qcom,little_cold_bat_decidegc = <0>;	/*0C~5C*/
	qcom,temp_little_cold_vfloat_mv = <4435>;
	qcom,temp_little_cold_fastchg_current_ma_high = <1840>;	     /*0.95*0.5C-64~0.95*0.5C*/
	qcom,temp_little_cold_fastchg_current_ma_low = <1100>;		/*0.95*0.3C-64~0.95*0.3C*/
	qcom,pd_temp_little_cold_fastchg_current_ma_high = <1850>;
	qcom,pd_temp_little_cold_fastchg_current_ma_low = <1100>;
 	qcom,temp_little_cold_fastchg_current_ma = <1076>;

	qcom,cool_bat_decidegc = <50>;	/*5C~12C*/
	qcom,temp_cool_vfloat_mv = <4435>;
	qcom,temp_cool_fastchg_current_ma_high = <2200>;          /*0.95*0.7C-64~0.95*0.7C*/
	qcom,temp_cool_fastchg_current_ma_low = <1840>;          /*0.95*0.5C-64~0.95*0.5C*/
	qcom,pd_temp_cool_fastchg_current_ma_high = <2200>;
	qcom,pd_temp_cool_fastchg_current_ma_low = <1850>;

	qcom,little_cool_bat_decidegc = <120>;	/*12C~16C*/
	qcom,temp_little_cool_vfloat_mv = <4435>;
	qcom,temp_little_cool_fastchg_current_ma = <2200>;       /*0.95C-64~0.95C*/
	qcom,pd_temp_little_cool_fastchg_current_ma = <3300>;

	qcom,normal_bat_decidegc = <160>;	/*16C~44C*/
	qcom,temp_normal_fastchg_current_ma = <2200>;            /*0.95*1.45C-64~0.95*1.45C*/
	qcom,pd_temp_normal_fastchg_current_ma = <3300>;
	qcom,temp_normal_vfloat_mv = <4435>;

	qcom,warm_bat_decidegc = <450>;		/*45C~53C*/
	qcom,temp_warm_vfloat_mv = <4130>;
	qcom,temp_warm_fastchg_current_ma = <1100>;
	qcom,pd_temp_warm_fastchg_current_ma = <1100>;
	qcom,temp_warm_fastchg_current_ma_led_on = <500>;
	qcom,hot_bat_decidegc = <530>;

	qcom,non_standard_vfloat_mv = <3980>;
	qcom,non_standard_fastchg_current_ma = <512>;

	qcom,short_c_bat_cv_mv = <4330>;
	qcom,short_c_bat_vfloat_mv = <3800>;
	qcom,short_c_bat_fastchg_current_ma = <512>;

	qcom,cold_vfloat_sw_limit = <3930>;
	qcom,little_cold_vfloat_sw_limit = <4385>;
	qcom,cool_vfloat_sw_limit = <4385>;
	qcom,little_cool_vfloat_sw_limit = <4385>;
	qcom,normal_vfloat_sw_limit = <4385>;
	qcom,warm_vfloat_sw_limit = <4080>;
	qcom,non_standard_vfloat_sw_limit = <3930>;
	qcom,short_c_bat_vfloat_sw_limit = <3750>;

	qcom,max_chg_time_sec = <36000>;
	qcom,charger_hv_thr = <5900>;
	qcom,charger_recv_thr = <5500>;
	qcom,charger_lv_thr = <3400>;
	qcom,vbatt_full_thr = <4400>;
	qcom,vbatt_hv_thr = <4550>;
	qcom,vfloat_step_mv = <8>;
	qcom,non_standard_vfloat_over_sw_limit = <3990>;
	qcom,cold_vfloat_over_sw_limit = <3990>;
	qcom,little_cold_vfloat_over_sw_limit = <4445>;
	qcom,cool_vfloat_over_sw_limit = <4445>;
	qcom,little_cool_vfloat_over_sw_limit = <4445>;
	qcom,normal_vfloat_over_sw_limit = <4445>;
	qcom,warm_vfloat_over_sw_limit = <4140>;

	qcom,vbatt_power_off = <3300>;
	qcom,vbatt_soc_1 = <3410>;
	qcom,vooc_project = <1>;
	qcom,vbatt_num = <1>;
	qcom,ffc_support;

	qcom,normal_vterm_hw_inc = <18>;
	qcom,non_normal_vterm_hw_inc = <18>;

	qcom,ff1_normal_fastchg_ma = <1500>;
	qcom,ff1_exit_step_ma = <600>;
	qcom,ff1_warm_exit_step_ma = <500>;
	qcom,ffc2_normal_fastchg_ma = <1050>;/*12C~35c*/
	qcom,ffc2_temp_warm_decidegc = <350>;
	qcom,ffc2_warm_fastchg_ma = <1150>;/*35C~40c*/
	qcom,ffc2_temp_high_decidegc = <400>;
	qcom,ffc2_temp_low_decidegc = <120>;
	qcom,ffc2_exit_step_ma = <150>;

	qcom,ffc_normal_vfloat_sw_limit = <4475>;
	qcom,ffc_temp_normal_vfloat_mv = <4550>;
	qcom,ffc_normal_vfloat_over_sw_limit = <4550>;

	qcom,default_iterm_ma = <215>;
	qcom,default_temp_normal_fastchg_current_ma = <2200>;
	qcom,default_normal_vfloat_sw_limit = <4385>;
	qcom,default_temp_normal_vfloat_mv = <4435>;
	qcom,default_normal_vfloat_over_sw_limit = <4445>;

	qcom,default_temp_little_cool_fastchg_current_ma = <2200>;
	qcom,default_little_cool_vfloat_sw_limit = <4385>;
	qcom,default_temp_little_cool_vfloat_mv = <4435>;
        qcom,default_little_cool_vfloat_over_sw_limit = <4445>;

	///qcom,offset_temp = <30>;
	//for control:
	//qcom,suspend_after_full;
	qcom,check_batt_full_by_sw;
	qcom,external_gauge;
	qcom,chg_ctrl_by_calling;
	qcom,chg_ctrl_by_lcd;
	qcom,chg_ctrl_by_camera;
	qcom,sw_vfloat_over_protect_enable;

	//GPIO config:
	qcom,chargerid_switch-gpio = <&pio 192 0x00>;
	qcom,ship-gpio = <&pio 126 0x00>;
	qcom,dischg-gpio = <&pio 28 0x00>;
	//qcom,shortc-gpio = <&pio 121 0x00>;
};

&i2c7 {
	bq27541-battery@55 {
		status = "okay";
		compatible = "oppo,bq27541-battery";
		reg = <0x55 0>;
		qcom,modify-soc-smooth;
		qcom,battery-full-param;
	};

	/*n76e_fastcg@52{
		status = "okay";
		compatible = "oppo,n76e-fastcg";
		reg = <0x52 0>;
		qcom,oppo_batt_4400mv;
		//qcom,vooc_fw_update_newmethod;

		pinctrl-names = "switch1_act_switch2_act", "switch1_sleep_switch2_sleep",
						"switch1_act_switch3_act", "switch1_sleep_switch3_sleep",
						"switch1_act_switch2_sleep", "switch1_sleep_switch2_act",
						"clock_active","clock_sleep",
						"data_active","data_sleep",
						"reset_active","reset_sleep";
		pinctrl-0 = <&charging_switch1_active>;
		pinctrl-1 = <&charging_switch1_sleep>;
		pinctrl-2 = <&charging_switch1_active>;
		pinctrl-3 = <&charging_switch1_sleep>;
		pinctrl-4 = <&charging_switch1_active>;
		pinctrl-5 = <&charging_switch1_sleep>;
		pinctrl-6 = <&charging_clock_active>;
		pinctrl-7 = <&charging_clock_sleep>;
		pinctrl-8 = <&charging_data_active>;
		pinctrl-9 = <&charging_data_sleep>;
		pinctrl-10 = <&charging_reset_active>;
		pinctrl-11 = <&charging_reset_sleep>;

		qcom,charging_switch1-gpio              = <&pio 148 0x00>;
		//qcom,charging_switch2-gpio            = <&tlmm 113 0x00>;
		//qcom,charging_switch3-gpio            = <&tlmm 38 0x00>;

		qcom,charging_reset-gpio                        = <&pio 21 0x00>;
		qcom,charging_clock-gpio                        = <&pio 74 0x00>;
		qcom,charging_data-gpio                         = <&pio 73 0x00>;
	};*/

	stm8s_fastcg@26{
		status = "okay";
		compatible = "oppo,stm8s-fastcg";
		reg = <0x26 0>;
		qcom,oppo_batt_4400mv;
		qcom,vooc-low-temp=<50>;
		qcom,vooc-high-temp=<430>;
		qcom,vooc-low-soc = <1>;
		qcom,vooc-high-soc = <85>;
		qcom,vooc_fw_update_newmethod;
		qcom,vooc-fw-type = <15>;

		qcom,vooc_multistep_adjust_current_support;
		qcom,vooc_multistep_initial_batt_temp = <1000>;
		qcom,vooc_strategy_normal_current = <0x06>;

		qcom,vooc_strategy1_batt_high_temp0 = <410>;
		qcom,vooc_strategy1_batt_high_temp1 = <425>;
		qcom,vooc_strategy1_batt_high_temp2 = <435>;
		qcom,vooc_strategy1_batt_low_temp2 = <430>;
		qcom,vooc_strategy1_batt_low_temp1 = <410>;
		qcom,vooc_strategy1_batt_low_temp0 = <390>;

		qcom,vooc_strategy1_high_current0 = <0x04>;//4A
		qcom,vooc_strategy1_high_current1 = <0x03>;//3A
		qcom,vooc_strategy1_high_current2 = <0x02>;//2A
		qcom,vooc_strategy1_low_current2 = <0x03>;//3A
		qcom,vooc_strategy1_low_current1 = <0x05>;//5A
		qcom,vooc_strategy1_low_current0 = <0x06>;//6A

		qcom,vooc_strategy2_batt_up_temp1 = <370>;
		qcom,vooc_strategy2_batt_up_down_temp2 = <380>;
		qcom,vooc_strategy2_batt_up_temp3 = <390>;
		qcom,vooc_strategy2_batt_up_down_temp4 = <395>;
		qcom,vooc_strategy2_batt_up_temp5 = <400>;
		qcom,vooc_strategy2_batt_up_temp6 = <415>;
		qcom,vooc_strategy2_high0_current = <0x06>;
		qcom,vooc_strategy2_high1_current = <0x06>;
		qcom,vooc_strategy2_high2_current = <0x06>;
		qcom,vooc_strategy2_high3_current = <0x06>;

		pinctrl-names = "switch1_act_switch2_act", "switch1_sleep_switch2_sleep",
						"switch1_act_switch3_act", "switch1_sleep_switch3_sleep",
						"switch1_act_switch2_sleep", "switch1_sleep_switch2_act",
						"clock_active","clock_sleep",
						"data_active","data_sleep",
						"reset_active","reset_sleep";
		pinctrl-0 = <&charging_switch1_active>;
		pinctrl-1 = <&charging_switch1_sleep>;
		pinctrl-2 = <&charging_switch1_active>;
		pinctrl-3 = <&charging_switch1_sleep>;
		pinctrl-4 = <&charging_switch1_active>;
		pinctrl-5 = <&charging_switch1_sleep>;
		pinctrl-6 = <&charging_clock_active>;
		pinctrl-7 = <&charging_clock_sleep>;
		pinctrl-8 = <&charging_data_active>;
		pinctrl-9 = <&charging_data_sleep>;
		pinctrl-10 = <&charging_reset_active>;
		pinctrl-11 = <&charging_reset_sleep>;

		qcom,charging_switch1-gpio              = <&pio 191 0x00>;
		//qcom,charging_switch2-gpio            = <&tlmm 113 0x00>;
		//qcom,charging_switch3-gpio            = <&tlmm 38 0x00>;

		qcom,charging_reset-gpio                        = <&pio 189 0x00>;
		qcom,charging_clock-gpio                        = <&pio 187 0x00>;
		qcom,charging_data-gpio                         = <&pio 9 0x00>;
	};
};

&pio {
	charger_pins_default: eint0default {
	};

	charger_pins_eint_output0: charger_gpio_as_output_low {
		pins_cmd_dat {
			pinmux = <PINMUX_GPIO192__FUNC_GPIO192>;
			slew-rate = <1>;
			output-low;
		};
	};

	charger_pins_eint_output1: charger_gpio_as_output_high {
		pins_cmd_dat {
			pinmux = <PINMUX_GPIO192__FUNC_GPIO192>;
			slew-rate = <1>;
			output-high;
		};
	};

	ship_sleep_gpio: ship_sleep {
		pins_cmd_dat {
			pinmux = <PINMUX_GPIO126__FUNC_GPIO126>;
			slew-rate = <1>;
			output-low;
		};
	};

	ship_active_gpio: ship_active {
		pins_cmd_dat {
			pinmux = <PINMUX_GPIO126__FUNC_GPIO126>;
			slew-rate = <1>;
			output-high;
		};
	};

	dischg_enable: dischg_enable {
		pins_cmd_dat {
			pinmux = <PINMUX_GPIO28__FUNC_GPIO28>;
			slew-rate = <1>;//0:input direction 1:output direction
			bias-pull-up = <00>;
			output-high;
		};
	};

	dischg_disable: dischg_disable {
		pins_cmd_dat {
			pinmux = <PINMUX_GPIO28__FUNC_GPIO28>;
			slew-rate = <1>;
			bias-pull-down = <00>;
			output-low;
		};
	};

	/*shortc_active_gpio: shortc_active {
		pins_cmd_dat {
			pinmux = <PINMUX_GPIO121__FUNC_GPIO121>;
			input-enable;
			slew-rate = <0>;
			bias-pull-up;
		};
	};*/
};

&pio {
	charging_switch1_active: charging_switch1_active {
		pins_cmd_dat {
			pinmux = <PINMUX_GPIO191__FUNC_GPIO191>;
			slew-rate = <1>;
			output-high;
		};
	};

	charging_switch1_sleep: charging_switch1_sleep {
		pins_cmd_dat {
			pinmux = <PINMUX_GPIO191__FUNC_GPIO191>;
			slew-rate = <1>;
			output-low;
		};
	};

	charging_clock_active: charging_clock_active {
		pins_cmd_dat {
			pinmux = <PINMUX_GPIO187__FUNC_GPIO187>;
			slew-rate = <0>;
			bias-pull-up = <00>;
		};
	};

	charging_clock_sleep: charging_clock_sleep {
		pins_cmd_dat {
			pinmux = <PINMUX_GPIO187__FUNC_GPIO187>;
			slew-rate = <0>;
			bias-pull-down = <00>;
		};
	};

	charging_data_active: charging_data_active {
		pins_cmd_dat {
			pinmux = <PINMUX_GPIO9__FUNC_GPIO9>;
			slew-rate = <0>;
			bias-pull-up = <00>;
		};
	};

	charging_data_sleep: charging_data_sleep {
		pins_cmd_dat {
			pinmux = <PINMUX_GPIO9__FUNC_GPIO9>;
			slew-rate = <0>;
			bias-pull-down = <00>;
		};
	};

	charging_reset_active: charging_reset_active {
		pins_cmd_dat {
			pinmux = <PINMUX_GPIO189__FUNC_GPIO189>;
			slew-rate = <1>;
			output-high;
		};
	};

	charging_reset_sleep: charging_reset_sleep {
		pins_cmd_dat {
			pinmux = <PINMUX_GPIO189__FUNC_GPIO189>;
			slew-rate = <1>;
			output-low;
		};
	};
};

//#ifdef VENDOR_EDIT
//LiYue@BSP.CHG.Basic, 2019/10/02, Add for chargerid
&apuart0 {
	pinctrl-names = "uart0_rx_gpio",
			"uart0_tx_gpio";
	pinctrl-0 = <&uart0_rx_gpio_input>;
	pinctrl-1 = <&uart0_tx_gpio_input>;
	status = "okay";
};

&pio {
	uart0_rx_gpio_input:uart0_rx_gpio@gpio92 {
		pins_cmd_dat {
			pinmux = <PINMUX_GPIO92__FUNC_GPIO92>;
			input-enable;
			slew-rate = <0>;
			bias-disable;
		};
	};
	uart0_tx_gpio_input:uart0_tx_gpio@gpio93 {
		pins_cmd_dat {
			pinmux = <PINMUX_GPIO93__FUNC_GPIO93>;
			input-enable;
			slew-rate = <0>;
			bias-disable;
		};
	};
};
//#endif /* VENDOR_EDIT */

/* Audio start */
/* Yongzhi.Zhang@PSW.MM.AudioDriver.Feature, 2019/01/22,
 * modify for d4 */
&spi4 {
	#address-cells = <1>;
	#size-cells = <0>;

	dbmd4_spi:dbmd4_interface@0 {
		compatible = "dspg,dbmd4-spi";
		reg = <0>;
		spi-max-frequency = <1000000>;
		read-chunk-size  = <0x2000>;    /* 16*16*16*16*2 bytes   */
		write-chunk-size = <0x40000>;   /* 1000 bytes */
		dma_min_buffer_size = <0>;
		status = "okay";
	};
};

&dbmdx {

		reset-gpio = <&pio 19 0x0>; /* GPX1.3 */
		sv-gpio = <&pio 22 0x0>; /* GPX1.5 */
		wakeup-gpio = <&pio 27 0x0>; /* GPA0.1 */
		ldo-gpio = <&pio 127 0x0>; /* 1.1v */

		auto_buffering = <1>;
		multi-interface-support = <1>;
		cd-interfaces = <&dbmd4_spi>;
		va-interfaces = <0 0 0 0>;
		feature-va; /* enable VA */
		va-firmware-name = "dbmd4_va_fw.bin";
		va-config = <0x800C2400
			0x80290020
			0x802210A0
			0x80330056
			0x80091400
			0x80158E8E
			0x8018000A
			0x801b0020
			0x80230000
			0x801a0011
			0x80108000
			0x8aab0040
			0x805004B0
			0x805104B0
			0x80410001
			0x8060ef81
			0x8061f98f
			0x806221c0
			0x8063fb2f
			0x806421c0
			0x8065fb2f
			0x80660006
			0x80000000
			0x80000000
			0x80000000>;
		va-speeds = <0x0000 460800  0 960000
			0x0000 2000000 0 4800000
			0x0000 3000000 0 4800000>;
		va-mic-config = <0x5012 0x1044 0x0007>;
		va-mic-mode = <4>;

	//		digital_mic_digital_gain = <0x14>;
		analog_mic_analog_gain = <0x0E>;
	//		analog_mic_digital_gain = <0x14>;

		master-clk-rate = <32768>;
		/* constant-clk-rate = <32768>; */
		firmware_id = <0xdbd4>;
		use_gpio_for_wakeup = <1>; /* Use wakeup gpio */
		wakeup_set_value = <0>;  /* Value to write to wakeup gpio */
		auto_detection = <1>;
		detection_buffer_channels = <0>;
		min_samples_chunk_size = <128>;
		pcm_streaming_mode = <1>;
		boot_options = <0x200>; /* Verify chip id */
		amodel_options = <0x24>;
		send_uevent_on_detection = <1>;
		send_uevent_after_buffering = <0>;
		detection_after_buffering = <0>;
		va_backlog_length = <0x780>;
		va_advanced_options = <0x1D>; /* Split Passphrase/Buf, Send det and buf events, Send event after passphrase */
		va_passphrase_margins = <0x00320640>;
};
//#endif /* VENDOR_EDIT */

&pio {
	camera_af_pins_default: camafdefault {
	};
	camera_af_pins_en_0: camafen_low {
		pins_cmd_dat {
			pinmux = <PINMUX_GPIO30__FUNC_GPIO30>;
			slew-rate = <1>;
			output-low;
		};
	};
	camera_af_pins_en_1: camafen_high {
		pins_cmd_dat {
			pinmux = <PINMUX_GPIO30__FUNC_GPIO30>;
			slew-rate = <1>;
			output-high;
		};
	};
};

&camera_af_node {
	pinctrl-names = "default",
			"camafen_low", "camafen_high";
	pinctrl-0 = <&camera_af_pins_default>;
	pinctrl-1 = <&camera_af_pins_en_0>;
	pinctrl-2 = <&camera_af_pins_en_1>;
	status = "okay";
};

//#ifdef VENDOR_EDIT
//Anhui.Sun@PSW.NW.RF, 2018/12/19, Add for SWTP - RF cable detection
&swtp {
    compatible = "mediatek, swtp-eint";
};
//#endif  /*VENDOR_EDIT*/

 #include <oppo6885/cust.dtsi>
/*End of this file, DO NOT ADD ANYTHING HERE*/
